## conf/layer.conf
```bitbake
# We have a conf directory, append to BBPATH
BBPATH .= ":${LAYERDIR}"

# We have a recipes directory, add to BBFILES
BBFILES += "${LAYERDIR}/recipes-*/*/*.bb ${LAYERDIR}/recipes-*/*/*.bbappend"

BBFILE_COLLECTIONS += "meta-logicpd"
BBFILE_PATTERN_meta-logicpd := "^${LAYERDIR}/"
BBFILE_PRIORITY_meta-logicpd = "7"
```

## conf/machine/omap3logic.conf
```bitbake
#@TYPE: Machine
#@NAME: omap3logic machine
#@DESCRIPTION: Machine configuration for the LogicPD Omap3 boards

SOC_FAMILY = "omap3"
TARGET_ARCH = "arm"
# DEFAULTTUNE makes it possible to build for the ARM hardfloat ABI.
#DEFAULTTUNE ?= "cortexa8hf-neon"

require conf/machine/include/soc-family.inc
require conf/machine/include/tune-cortexa8.inc

# Specify kernel recipe
PREFERRED_PROVIDER_virtual/kernel ?= "linux-omap3"
# Increase this everytime you change something in the kernel
MACHINE_KERNEL_PR = "r1"
KERNEL_IMAGETYPE = "uImage"

# Specify u-boot parameters
PREFERRED_PROVIDER_virtual/bootloader = "u-boot-omap3"

UBOOT_ENTRYPOINT = "0x80008000"
UBOOT_LOADADDRESS = "0x80008000"
UBOOT_MACHINE = "omap3_logic_config"

EXTRA_IMAGEDEPENDS += " virtual/bootloader"

# Specify xserver components for builds including X11
PREFERRED_PROVIDER_virtual/xserver = "xserver-xorg"
XSERVER ?= "xserver-xorg \
           xf86-input-evdev \
           xf86-input-mouse \
           xf86-video-omapfb \
           xf86-input-keyboard"

# For kernels older than 2.6.37, use "115200 ttyS2" instead
SERIAL_CONSOLE = "115200 ttyO0"

# tar.bz2 for SD card, UBI for nand
IMAGE_FSTYPES += "tar.bz2 ubi"

MKUBIFS_ARGS = "-m 2048 -e 129024 -c 4044"
UBINIZE_ARGS = "-m 2048 -p 128KiB -s 512"

UBI_VOLNAME = "rootfs"

# Ship all kernel modules by default
MACHINE_EXTRA_RRECOMMENDS = ""
MACHINE_FEATURES = "ext3 usbgadget vfat wifi rtc"
```

## recipes-kernel/linux/linux-omap3-3.2.0/omap3logic/Kconfig.patch
```kconfig
diff --git a/arch/arm/mach-omap2/Kconfig b/arch/arm/mach-omap2/Kconfig
--- a/arch/arm/mach-omap2/Kconfig
+++ b/arch/arm/mach-omap2/Kconfig
@@ -177,6 +177,26 @@ config MACH_OMAP3_TORPEDO
 	 for full description please see the products webpage at
 	 http://www.logicpd.com/products/development-kits/zoom-omap35x-torpedo-development-kit
 
+config MACH_DM3730_SOM_LV
+	bool "Logic DM373x SOM LV board"
+	depends on ARCH_OMAP3
+	select OMAP_PACKAGE_CBP
+	default y
+	help
+	 Support for the LogicPD DM37x SOM Development kit
+	 for full description please see the products webpage at
+	 http://www.logicpd.com/products/development-kits/dm3730-som-lv-devkit
+
+config MACH_DM3730_TORPEDO
+	bool "Logic DM37x Torpedo board"
+	depends on ARCH_OMAP3
+	select OMAP_PACKAGE_CBP
+	default y
+	help
+	 Support for the LogicPD DM37x Torpedo Development kit
+	 for full description please see the products webpage at
+	 http://www.logicpd.com/products/development-kits/dm3730-torpedo-devkit
+
 config MACH_OVERO
 	bool "Gumstix Overo board"
 	depends on ARCH_OMAP3
```
